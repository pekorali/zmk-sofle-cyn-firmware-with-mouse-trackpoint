## config/west.yml
```yaml
manifest:
  remotes:
    #- name: zmkfirmware
    #  url-base: https://github.com/zmkfirmware
    - name: petejohanson
      url-base: https://github.com/petejohanson
    - name: pekorali
      url-base: https://github.com/pekorali
  projects:
    - name: zmk
      remote: petejohanson
      #revision: v0.3
      revision: core/main-work-queue
      import: app/west.yml

    # Module for PS/2 mouse & TP driver
    - name: kb_zmk_ps2_mouse_trackpoint_driver
      remote: pekorali
      revision: main

  self:
    path: config
```
